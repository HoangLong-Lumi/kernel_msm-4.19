/dts-v1/;

#include "sdm632.dtsi"
#include "sdm450-pmi632.dtsi"

/ {
	model = "Qualcomm Technologies, Inc. SDM632 + PMI632 SOC";
	compatible = "qcom,sdm450";
	qcom,pmic-id = <0x010016 0x25 0x0 0x0>;
	qcom,pmic-name = "PMI632";
};
