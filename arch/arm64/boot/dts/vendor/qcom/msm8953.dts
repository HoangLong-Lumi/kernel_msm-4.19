/dts-v1/;

#include "msm8953.dtsi"
#include "pmi8950.dtsi"
#include "msm8953-pmi8950.dtsi"

/ {
	model = "Qualcomm Technologies, Inc. MSM8953 + PMI8950 SOC";
	compatible = "qcom,msm8953";
	qcom,pmic-id = <0x010016 0x010011 0x0 0x0>;
	qcom,pmic-name = "PMI8950";
};
